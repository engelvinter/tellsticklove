## meta-tellsticklove/conf/layer.conf
```bitbake
# We have a conf and classes directory, add to BBPATH
BBPATH .= ":${LAYERDIR}"

# We have recipes-* directories, add to BBFILES
BBFILES += "${LAYERDIR}/recipes-*/*/*.bb \
            ${LAYERDIR}/recipes-*/*/*.bbappend"

BBFILE_COLLECTIONS += "meta-tellsticklove"
BBFILE_PATTERN_meta-tellsticklove = "^${LAYERDIR}/"
BBFILE_PRIORITY_meta-tellsticklove = "6"

LAYERDEPENDS_meta-tellsticklove = "core"
LAYERSERIES_COMPAT_meta-tellsticklove = "scarthgap"
```
